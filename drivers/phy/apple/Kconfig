## drivers/phy/apple/Kconfig
```kconfig
# SPDX-License-Identifier: GPL-2.0
#
# Phy drivers for Apple SoCs
#
config PHY_APPLE_ATC_M1
	tristate "Apple SoCs USB PHY Driver"
	depends on ARCH_APPLE
	depends on TYPEC
	select GENERIC_PHY
	help
	  This driver provides support for universal type-C PHY (ATCPHY)
	  found on Apple M1 SoC.
```

## drivers/phy/cix/Kconfig
```kconfig
# SPDX-License-Identifier: GPL-2.0-only

config PHY_CIX_PCIE
	bool "CIX Sky1 PCIe PHY driver"
	depends on ARCH_CIX || COMPILE_TEST
	depends on OF
	select GENERIC_PHY
	help
	  Enable this to support the PCIe PHY on CIX Sky1 SoCs.
	  This driver provides PHY support for the Cadence PCIe controller
	  on CIX Sky1 platforms.

config PHY_CIX_USB2
	bool "CIX Sky1 USB2 PHY driver"
	depends on ARCH_CIX || COMPILE_TEST
	depends on OF
	select GENERIC_PHY
	help
	  Enable this to support the USB2 PHY on CIX Sky1 SoCs.

config PHY_CIX_USB3
	bool "CIX Sky1 USB3 PHY driver"
	depends on ARCH_CIX || COMPILE_TEST
	depends on OF
	select GENERIC_PHY
	help
	  Enable this to support the USB3 PHY on CIX Sky1 SoCs.

config PHY_CIX_USBDP
	tristate "CIX Sky1 USB-DP combo PHY driver"
	depends on ARCH_CIX || COMPILE_TEST
	depends on OF
	depends on TYPEC
	select GENERIC_PHY
	help
	  Enable this to support the USB-DP combo PHY on CIX Sky1 SoCs.
	  This PHY supports both USB3 and DisplayPort alternate mode.
```

## drivers/soc/cix/Kconfig
```kconfig
# SPDX-License-Identifier: GPL-2.0-only

config CIX_ACPI_RESOURCE_LOOKUP
	bool "CIX ACPI resource lookup driver"
	depends on ARCH_CIX || COMPILE_TEST
	depends on ACPI
	depends on RESET_CONTROLLER
	default ARCH_CIX
	help
	  Processes custom CIX DSDT tables (RSTL, RSNL, DLKL) to register
	  reset control lookups, assign names to platform resources, and
	  create device link dependencies. This bridges CIX's ACPI firmware
	  with the Linux kernel's standard resource lookup mechanisms.

	  Required for CIX Sky1 ACPI boot with drivers that use
	  platform_get_resource_byname() or devm_reset_control_get().
```

## drivers/staging/apfs/Kconfig
```kconfig
# SPDX-License-Identifier: GPL-2.0-only
config APFS_FS
	tristate "Apple File System support"
	select LIBCRC32C
	select ZLIB_INFLATE
	select NLS
	select BUFFER_HEAD
	select FS_IOMAP
	select LEGACY_DIRECT_IO
	help
	  If you say Y here, you will be able to mount APFS partitions
	  with read-only access. Write access is experimental and may
	  corrupt your container.
```

## sound/soc/apple/Kconfig
```kconfig
config SND_SOC_APPLE_SILICON
	tristate "ASoC machine driver for Apple Silicon Macs"
	depends on ARCH_APPLE || COMPILE_TEST
	select SND_SOC_APPLE_MCA
	select SND_SIMPLE_CARD_UTILS
	default ARCH_APPLE
	help
	  This option enables an ASoC machine driver for Apple Silicon Macs.

config SND_SOC_APPLE_MCA
	tristate "Apple Silicon MCA driver"
	depends on ARCH_APPLE || COMPILE_TEST
	select SND_DMAENGINE_PCM
	select CONFIG_COMMON_CLK
	select APPLE_ADMAC
	select APPLE_NCO
	default ARCH_APPLE
	help
	  This option enables an ASoC platform driver for MCA blocks found
	  on Apple Silicon SoCs.
```

## sound/soc/cix/Kconfig
```kconfig
# SPDX-License-Identifier: GPL-2.0-only

config SND_SOC_CIX
	tristate "ASoC support for CIX SoCs"
	depends on ARCH_CIX || COMPILE_TEST
	help
	  Say Y or M if you want to add support for codecs attached to
	  the CIX SoC audio interfaces. You will also need to select the
	  audio interfaces to support below.

config SND_SOC_CDNS_I2S_MC
	tristate "Cadence I2S Multi-Channel Controller"
	depends on SND_SOC_CIX
	select SND_SOC_GENERIC_DMAENGINE_PCM
	help
	  Say Y or M if you want to add support for the Cadence I2S
	  Multi-Channel controller used in CIX Sky1 SoCs. This controller
	  supports up to 16 audio channels.

config SND_SOC_CDNS_I2S_SC
	tristate "Cadence I2S Single-Channel Controller"
	depends on SND_SOC_CIX
	select SND_SOC_GENERIC_DMAENGINE_PCM
	help
	  Say Y or M if you want to add support for the Cadence I2S
	  Single-Channel controller used in CIX Sky1 SoCs. This controller
	  supports stereo (2-channel) audio.

config SND_SOC_SKY1_SOUND_CARD
	tristate "CIX Sky1 Sound Card"
	depends on SND_SOC_CIX
	select MFD_SYSCON
	help
	  Say Y or M if you want to add support for the CIX Sky1 ASoC
	  machine driver. This driver provides DAI link configuration,
	  jack detection, and MCLK setup for audio codecs connected
	  to the Sky1 SoC.
```

## sound/soc/loongson-gd/Kconfig
```kconfig
menuconfig SND_SOC_LOONGSON
	tristate "ASoC support for loongson"

if SND_SOC_LOONGSON

config SND_LS
	tristate "SoC Audio for ls-i2s"
	help
	  Say Y or M if you want to add support for codecs attached to
	  the I2S interface. You will also need to select the Audio
		interfaces to support below.

config SND_LS_PCM
	tristate "SoC Audio for ls-pcm used descriptor"
	help
	  Say Y or M if you want to add support for codecs attached to
	  the PCM interface. Select this by configuring the dma of the descriptor.

config SND_LS_PCM_GENERIC_DMA
	tristate "SoC Audio for ls-pcm used generic dma"
	help
	  Say Y or M if you want to add support for codecs attached to
	  the PCM interface. Select this by configuring the generic dma.

config SND_LS_DAILINK
	tristate "SoC Audio for Sound-Card/Dai-Link"
	depends on SND_LS
	default y

endif #SND_SOC_LOONGSON
```
