## Documentation/devicetree/bindings/phy/spacemit,k3-usb3-phy.yaml
```yaml
# SPDX-License-Identifier: (GPL-2.0-only OR BSD-2-Clause)
%YAML 1.2
---
$id: http://devicetree.org/schemas/phy/spacemit,k3-usb3-phy.yaml#
$schema: http://devicetree.org/meta-schemas/core.yaml#
title: SpacemiT K3 USB Port A PIPE PHYs
maintainers:
  - Han Gao <gaohan@iscas.ac.cn>
description:
  Port A has two dedicated PIPE PHYs selected according to Type-C cable
  orientation. Both must be parked when operating with only the UTMI PHY.
properties:
  compatible:
    const: spacemit,k3-usb3-phy
  reg:
    items:
      - description: First orientation PIPE PHY registers
      - description: Second orientation PIPE PHY registers
  clocks:
    maxItems: 1
  spacemit,syscon-apb-spare:
    $ref: /schemas/types.yaml#/definitions/phandle
    description: Shared PHY resistance calibration register block.
  '#phy-cells':
    const: 0
required:
  - compatible
  - reg
  - clocks
  - spacemit,syscon-apb-spare
  - '#phy-cells'
additionalProperties: false
```

## Documentation/devicetree/bindings/usb/onsemi,fusb301.yaml
```yaml
# SPDX-License-Identifier: (GPL-2.0-only OR BSD-2-Clause)
%YAML 1.2
---
$id: http://devicetree.org/schemas/usb/onsemi,fusb301.yaml#
$schema: http://devicetree.org/meta-schemas/core.yaml#

title: onsemi FUSB301 autonomous USB Type-C controller

maintainers:
  - Han Gao <gaohan@iscas.ac.cn>

description: |
  FUSB301 detects Type-C attachment, partner current advertisement and
  cable orientation. It does not implement USB Power Delivery. Its ID
  output can control an external VBUS switch independently of software.

properties:
  compatible:
    const: onsemi,fusb301

  reg:
    maxItems: 1

  interrupts:
    maxItems: 1

  vbus-supply:
    description: Optional software-controlled source VBUS supply.

  connector:
    type: object
    $ref: /schemas/connector/usb-connector.yaml#
    unevaluatedProperties: false
    properties:
      compatible:
        const: usb-c-connector
      try-power-role: false
    required:
      - pd-disable
      - power-role

required:
  - compatible
  - reg
  - interrupts
  - connector

additionalProperties: false

examples:
  - |
    #include <dt-bindings/interrupt-controller/irq.h>
    i2c {
        #address-cells = <1>;
        #size-cells = <0>;
        typec@25 {
            compatible = "onsemi,fusb301";
            reg = <0x25>;
            interrupts-extended = <&gpio 85 IRQ_TYPE_LEVEL_LOW>;
            connector {
                compatible = "usb-c-connector";
                power-role = "dual";
                data-role = "dual";
                typec-power-opmode = "default";
                pd-disable;
            };
        };
    };
```
