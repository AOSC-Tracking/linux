## drivers/clk/loongson/Kconfig
```kconfig
# SPDX-License-Identifier: GPL-2.0-only

config COMMON_CLK_LOONGSON2X
	bool "Clock drivers for Loongson2 SOCs"
	depends on LOONGSON_2K1000 || LOONGSON_2K500 || LOONGSON_2K300
	default LOONGSON_2K1000 || LOONGSON_2K500 || LOONGSON_2K300
	help
	  Supports clock drivers for Loongson2 SOCs.

choice
	bool "System clock mode Selection"
    depends on COMMON_CLK_LOONGSON2X
    default LOONGSON2_SYSCLK_SOFT

	config LOONGSON2_SYSCLK_HW_LOWFREQ
		bool "Hardware low frequency mode"
		help
		System clock select Hardware low frequency mode.

	config LOONGSON2_SYSCLK_HW_HIGFREQ
		bool "Hardware hige frequency mode"
		help
		System clock select Hardware hige frequency mode.

	config LOONGSON2_SYSCLK_SOFT
		bool "Soft mode"
		help
		System clock select Soft mode.

	config LOONGSON2_SYSCLK_HW_BYPASS
		bool "Hardware bypass mode"
		help
		System clock select Hardware bypass mode.

endchoice
```

## drivers/firmware/cix/Kconfig
```kconfig
# SPDX-License-Identifier: GPL-2.0-only

config CIX_DSP
	tristate "CIX DSP IPC driver"
	depends on ARCH_CIX || COMPILE_TEST
	depends on MAILBOX
	help
	  This driver provides IPC communication helpers for the CIX DSP.
	  It is used by the Sound Open Firmware (SOF) driver to communicate
	  with the audio DSP on CIX Sky1 SoCs.

	  If unsure, say N.
```

## drivers/gpu/drm/asahi/Kconfig
```kconfig
# SPDX-License-Identifier: GPL-2.0

config DRM_ASAHI
	tristate "Asahi (DRM support for Apple AGX GPUs)"
	depends on RUST
	depends on DRM
	depends on (ARM64 && ARCH_APPLE) || (COMPILE_TEST && !GENERIC_ATOMIC64)
	depends on MMU
	select DRM_SCHED
	select IOMMU_SUPPORT
	select IOMMU_IO_PGTABLE_LPAE
	select DRM_GEM_SHMEM_HELPER
	help
	  DRM driver for Apple AGX GPUs (G13x, found in the M1 SoC family)

config DRM_ASAHI_DEBUG_ALLOCATOR
	bool "Use debug allocator"
	depends on DRM_ASAHI
	help
	  Use an alternate, simpler allocator which significantly reduces
	  performance, but can help find firmware- or GPU-side memory safety
	  issues.
```

## drivers/net/can/ls_canfd/Kconfig
```kconfig
menuconfig CAN_LSCANFD
	tristate "Support LSCAN devices"
	depends on HAS_IOMEM

if CAN_LSCANFD

config CAN_LSCANFD_PLATFORM
	tristate "Generic Platform Bus based LSCAN driver"
	help
	  This driver adds support for the 2K chips connected to
	  the "platform bus" (Linux abstraction for directly to the
	  processor attached devices).  Which can be found on various
	  boards from Phytec (http://www.phytec.de) like the PCM027,
	  PCM038. It also provides the OpenFirmware "platform bus" found
	  on embedded systems with OpenFirmware bindings, e.g. if you
	  have a PowerPC based system you may want to enable this option.
endif
```
