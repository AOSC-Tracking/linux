## Documentation/devicetree/bindings/edac/loongson,ls3a5000-mc-edac.yaml
```yaml
# SPDX-License-Identifier: GPL-2.0-only OR BSD-2-Clause
%YAML 1.2
---
$id: http://devicetree.org/schemas/edac/loongson,ls3a5000-mc-edac.yaml#
$schema: http://devicetree.org/meta-schemas/core.yaml#

title: Loongson Memory Controller EDAC

maintainers:
  - Zhao Qunqin <zhaoqunqin@loongson.cn>

description: |
  EDAC node is defined to describe on-chip error detection and correction for
  Loongson Memory Controller.

properties:
  compatible:
    oneOf:
      - enum:
          - loongson,ls3a5000-mc-edac
      - items:
          - enum:
              - loongson,ls3c5000l-mc-edac
              - loongson,ls3c5000-mc-edac
              - loongson,ls3d5000-mc-edac
              - loongson,ls3a6000-mc-edac
              - loongson,ls3c6000-mc-edac
          - const: loongson,ls3a5000-mc-edac

  reg:
    maxItems: 1

required:
  - compatible
  - reg

additionalProperties: false

examples:
  - |
    memory-controller@1fe00600 {
        compatible = "loongson,ls3a5000-mc-edac";
        reg = <0x1fe00600 0x50>;
    };
```

## Documentation/devicetree/bindings/mfd/sun4i-gpadc.txt
```
Allwinner SoCs' GPADC Device Tree bindings
------------------------------------------
The Allwinner SoCs all have an ADC that can also act as a thermal sensor
and sometimes as a touchscreen controller.

Required properties:
  - compatible: must contain one of the following compatibles:
		- "allwinner,sun8i-a33-ths"
		- "allwinner,sun8i-h3-ths"
		- "allwinner,sun8i-a83t-ths"
  - reg: mmio address range of the chip,
  - #thermal-sensor-cells: shall be 0 or 1,
  - #io-channel-cells: shall be 0,

Required properties for the following compatibles:
		- "allwinner,sun8i-h3-ths"
		- "allwinner,sun8i-a83t-ths"
  - interrupts: the sampling interrupt of the ADC,

Required properties for the following compatibles:
		- "allwinner,sun8i-h3-ths"
  - clocks: the bus clock and the input clock of the ADC,
  - clock-names: should be "bus" and "mod",
  - resets: the bus reset of the ADC,

Optional properties for the following compatibles:
		- "allwinner,sun8i-h3-ths"
  - nvmem-cells: A phandle to the calibration data provided by a nvmem device.
		If unspecified default values shall be used. The size should
		be 0x2 * sensorcount.
  - nvmem-cell-names: Should be "calibration".

Details see: bindings/nvmem/nvmem.txt

Example for A33:
	ths: ths@1c25000 {
		compatible = "allwinner,sun8i-a33-ths";
		reg = <0x01c25000 0x100>;
		#thermal-sensor-cells = <0>;
		#io-channel-cells = <0>;
	};

Example for H3:
	ths: thermal-sensor@1c25000 {
		compatible = "allwinner,sun8i-h3-ths";
		reg = <0x01c25000 0x400>;
		clocks = <&ccu CLK_BUS_THS>, <&ccu CLK_THS>;
		clock-names = "bus", "mod";
		resets = <&ccu RST_BUS_THS>;
		interrupts = <GIC_SPI 31 IRQ_TYPE_LEVEL_HIGH>;
		#thermal-sensor-cells = <0>;
		#io-channel-cells = <0>;
	};

Example for A83T:
	ths: thermal-sensor@1f04000 {
		compatible = "allwinner,sun8i-a83t-ths";
		reg = <0x01f04000 0x100>;
		interrupts = <GIC_SPI 41 IRQ_TYPE_LEVEL_HIGH>;
		#thermal-sensor-cells = <1>;
		#io-channel-cells = <0>;
	};

sun4i, sun5i and sun6i SoCs are also supported via the older binding:

sun4i resistive touchscreen controller
--------------------------------------

Required properties:
 - compatible: "allwinner,sun4i-a10-ts", "allwinner,sun5i-a13-ts" or
   "allwinner,sun6i-a31-ts"
 - reg: mmio address range of the chip
 - interrupts: interrupt to which the chip is connected
 - #thermal-sensor-cells: shall be 0

Optional properties:
 - allwinner,ts-attached	 : boolean indicating that an actual touchscreen
				   is attached to the controller
 - allwinner,tp-sensitive-adjust : integer (4 bits)
				   adjust sensitivity of pen down detection
				   between 0 (least sensitive) and 15
				   (defaults to 15)
 - allwinner,filter-type	 : integer (2 bits)
				   select median and averaging filter
				   samples used for median / averaging filter
				   0: 4/2
				   1: 5/3
				   2: 8/4
				   3: 16/8
				   (defaults to 1)

Example:

	rtp: rtp@1c25000 {
		compatible = "allwinner,sun4i-a10-ts";
		reg = <0x01c25000 0x100>;
		interrupts = <29>;
		allwinner,ts-attached;
		#thermal-sensor-cells = <0>;
		/* sensitive/noisy touch panel */
		allwinner,tp-sensitive-adjust = <0>;
		allwinner,filter-type = <3>;
	};
```

## Documentation/devicetree/bindings/net/bluetooth-controller.yaml
```yaml
# SPDX-License-Identifier: (GPL-2.0 OR BSD-2-Clause)
%YAML 1.2
---
$id: http://devicetree.org/schemas/net/bluetooth-controller.yaml#
$schema: http://devicetree.org/meta-schemas/core.yaml#

title: Bluetooth Controller Generic Binding

maintainers:
  - John Doe <john@example.com> # TODO: bluetooth maintainers probably

properties:
  $nodename:
    pattern: "^bluetooth(@.*)?$"

  local-bd-address:
    $ref: /schemas/types.yaml#/definitions/uint8-array
    minItems: 6
    maxItems: 6
    description:
      Specifies the BD address that was uniquely assigned to the Bluetooth
      device. Formatted with least significant byte first (little-endian), e.g.
      in order to assigne the address 00:11:22:33:44:55 this property must have
      the value [55 44 33 22 11 00].

additionalProperties: true

...
```

## Documentation/devicetree/bindings/net/realtek,rtl8211e.txt
```
Realtek RTL8211E Ethernet PHY

One batch of RTL8211E is slight broken, that needs some special (and
full of magic numbers) tweaking in order to make GbE to operate properly.
The only well-known board that used the broken batch is Pine64+.
Configure it through an Ethernet OF device node.

Optional properties:

- realtek,config-magic-for-pine64:
  Apply some magic configuration from Realtek that works around broken RTL8211E
  PHYs on Pine64+ boards.

Examples:
Pine64+ with broken RTL8211E:
&mdio {
	ext_phy: ethernet-phy@0 {
		reg = <0>;
		realtek,config-magic-for-pine64;
	};
};
```

## Documentation/devicetree/bindings/pinctrl/loongson,ls2k0300-pinctrl.yaml
```yaml
# SPDX-License-Identifier: (GPL-2.0-only OR BSD-2-Clause)
%YAML 1.2
---
$id: http://devicetree.org/schemas/pinctrl/loongson,ls2k0300-pinctrl.yaml#
$schema: http://devicetree.org/meta-schemas/core.yaml#

title: Loongson-2K0300 SoC Pinctrl Controller

maintainers:
  - Yao Zi <ziyao@disroot.org>

allOf:
  - $ref: pinctrl.yaml#

properties:
  compatible:
    const: loongson,ls2k0300-pinctrl

  reg:
    items:
      - description: Pin function-multiplexing configuration registers
      - description: Pin drive-strength configuration registers

  reg-names:
    items:
      - const: mux
      - const: drive

patternProperties:
  '^func-':
    type: object

    $ref: pincfg-node.yaml#

    properties:
      drive-strength:
        description:
          Maximum sink or source current as defined in pincfg-node.yaml. Note
          that drive strength could only be configured on function basis, i.e.,
          all pins multiplexed to the same function share the same
          configuration.

          This could only be configured for several functions, including jtag,
          dvo, uart, gmac, sdio, spi, i2s, timer, usb and emmc.
        enum: [2, 3, 4, 5, 6, 7, 8, 9, 10, 11, 12]

    additionalProperties: false

    patternProperties:
      '-pins$':
        type: object
        $ref: pinmux-node.yaml#

        properties:
          pinmux:
            description:
              Integer array, represents GPIO pin number and multiplexing
              setting. Configuration for each pin takes one cell. The pin
              number locates at the high 24 bits, and the setting locates at
              the low 8 bits.

        additionalProperties: false

        required:
          - pinmux

required:
  - compatible
  - reg
  - reg-names

additionalProperties: false

examples:
  - |
    pinctrl@1fe00420 {
        compatible = "loongson,ls2k0300-pinctrl";
        reg = <0x16000490 0x20>, <0x16000110 0x4>;
        reg-names = "mux", "drive";

        func-uart {
            drive-strength = <2>;

            uart0-pins {
                pinmux = <((40 << 8) | 0x3)>, <((41 << 8) | 0x3)>;
            };

            uart1_pins: uart1-pins {
                pinmux = <((42 << 8) | 0x3)>, <((43 << 8) | 0x3)>;
            };
        };
    };
```

## Documentation/devicetree/bindings/reset/cix,sky1-rst.yaml
```yaml
# SPDX-License-Identifier: (GPL-2.0-only OR BSD-2-Clause)
%YAML 1.2
---
$id: http://devicetree.org/schemas/reset/cix,sky1-rst.yaml#
$schema: http://devicetree.org/meta-schemas/core.yaml#

title: CIX Sky1 Reset Controller

maintainers:
  - Gary Yang <gary.yang@cixtech.com>

description: |
  CIX Sky1 reset controller can be used to reset various set of peripherals.
  There are two reset controllers, one is located in S0 domain, the other
  is located in S5 domain.

  See also:
  - include/dt-bindings/reset/cix,sky1-rst.h

properties:
  compatible:
    items:
      - enum:
          - cix,sky1-rst
          - cix,sky1-rst-fch
      - const: syscon

  reg:
    maxItems: 1

  '#reset-cells':
    const: 1

required:
  - compatible
  - reg
  - '#reset-cells'

additionalProperties: false

examples:
  - |
    #include <dt-bindings/reset/cix,sky1-rst.h>
    reset-controller@16000000 {
      compatible = "cix,sky1-rst", "syscon";
      reg = <0x16000000 0x1000>;
      #reset-cells = <1>;
    };
```

## Documentation/devicetree/bindings/reset/loongson,ls2k0300-reset.yaml
```yaml
# SPDX-License-Identifier: (GPL-2.0 OR BSD-2-Clause)
%YAML 1.2
---
$id: http://devicetree.org/schemas/reset/loongson,ls2k0300-reset.yaml#
$schema: http://devicetree.org/meta-schemas/core.yaml#

title: Loongson 2K0300 SoC Reset Controller

maintainers:
  - Yao Zi <ziyao@disroot.org>

properties:
  compatible:
    const: loongson,ls2k0300-reset

  reg:
    maxItems: 1

  "#reset-cells":
    const: 1

required:
  - compatible
  - reg
  - "#reset-cells"

additionalProperties: false

examples:
  - |
    rst: reset-controller@1600011c {
        compatible = "loongson,ls2k0300-reset";
        reg = <0x1600011c 0x8>;
        #reset-cells = <1>;
    };
```

## Documentation/devicetree/bindings/serial/loongson,uart.yaml
```yaml
# SPDX-License-Identifier: (GPL-2.0-only OR BSD-2-Clause)
%YAML 1.2
---
$id: http://devicetree.org/schemas/loongson,uart.yaml#
$schema: http://devicetree.org/meta-schemas/core.yaml#

title: Loongson UART

maintainers:
  - Haowei Zheng <zhenghaowei@loongson.cn>

allOf:
  - $ref: serial.yaml

properties:
  compatible:
    oneOf:
      - enum:
          - loongson,ls7a-uart
          - loongson,ls3a5000-uart
          - loongson,ls2k2000-uart
      - items:
          - enum:
              - loongson,ls2k1000-uart
              - loongson,ls2k0500-uart
          - const: loongson,ls7a-uart
      - items:
          - enum:
              - loongson,ls2k1500-uart
          - const: loongson,ls2k2000-uart
      - items:
          - enum:
              - loongson,ls3a6000-uart
          - const: loongson,ls3a5000-uart

  reg:
    maxItems: 1

  interrupts:
    maxItems: 1

  clock-frequency: true

required:
  - compatible
  - reg
  - interrupts
  - clock-frequency

unevaluatedProperties: false

examples:
  - |
    #include <dt-bindings/interrupt-controller/irq.h>
    #include <dt-bindings/clock/loongson,ls2k-clk.h>

    serial@1fe20000 {
        compatible = "loongson,ls2k1000-uart", "loongson,ls7a-uart";
        reg = <0x1fe20000 0x10>;
        clock-frequency = <125000000>;
        interrupt-parent = <&liointc0>;
        interrupts = <0x0 IRQ_TYPE_LEVEL_HIGH>;
    };
```

## Documentation/devicetree/bindings/thermal/sun8i-thermal.yaml
```yaml
# SPDX-License-Identifier: GPL-2.0
%YAML 1.2
---
$id: http://devicetree.org/schemas/thermal/sun8i-thermal.yaml#
$schema: http://devicetree.org/meta-schemas/core.yaml#

title: Allwinner SUN8I Thermal Controller Device Tree Bindings

maintainers:
  - Yangtao Li <tiny.windzz@gmail.com>

description: |-
  This describes the device tree binding for the Allwinner thermal
  controller which measures the on-SoC temperatures.

properties:
  compatible:
    enum:
      - allwinner,sun8i-h3-ths
      - allwinner,sun50i-h6-ths

  reg:
    maxItems: 1

  interrupts:
    maxItems: 1

  resets:
    maxItems: 1

  clocks:
    minItems: 1
    maxItems: 2

  clock-names:
    items:
      - const: bus
      - const: mod

  '#thermal-sensor-cells':
    enum: [ 0, 1 ]
    description: |
      Definition depends on sensor number:

      For "allwinner,sun8i-h3-ths",
      value must be 0.
      For other supported sensors,
      value must be 1.

  nvmem-cells:
    items:
      - description: ths calibrate data

  nvmem-cell-names:
    items:
      - const: calib

required:
  - compatible
  - reg
  - reset
  - clocks
  - clock-names
  - interrupts
  - '#thermal-sensor-cells'

examples:
  - |
    ths: thermal-sensor@1c25000 {
         compatible = "allwinner,sun8i-h3-ths";
         reg = <0x01c25000 0x400>;
         clocks = <&ccu CLK_BUS_THS>, <&ccu CLK_THS>;
         clock-names = "bus", "mod";
         resets = <&ccu RST_BUS_THS>;
         interrupts = <GIC_SPI 31 IRQ_TYPE_LEVEL_HIGH>;
         nvmem-cells = <&tsen_calib>;
         nvmem-cell-names = "calib";
         #thermal-sensor-cells = <0>;
    };

  - |
    ths: thermal-sensor@5070400 {
         compatible = "allwinner,sun50i-h6-ths";
         reg = <0x05070400 0x100>;
         clocks = <&ccu CLK_BUS_THS>;
         clock-names = "bus";
         resets = <&ccu RST_BUS_THS>;
         interrupts = <GIC_SPI 15 IRQ_TYPE_LEVEL_HIGH>;
         nvmem-cells = <&tsen_calib>;
         nvmem-cell-names = "calib";
         #thermal-sensor-cells = <1>;
    };

...
```

## arch/loongarch/ow_syscall/Kconfig
```kconfig
# SPDX-License-Identifier: GPL-2.0
#
# Old-world system call compat
#

config LOONGARCH_OW_SYSCALL
	tristate "Old-world system call compatibility module"
	depends on m
	help
	  Say M to compile support for old-world system calls
 	  as a module. This is needed to run liblol and programs
	  compiled for old world.

	  If unsure, say N.
```

## drivers/cache/Kconfig
```kconfig
# SPDX-License-Identifier: GPL-2.0
menu "Cache Drivers"

if GENERIC_CPU_CACHE_MAINTENANCE

config HISI_SOC_HHA
	tristate "HiSilicon Hydra Home Agent (HHA) device driver"
	depends on (ARM64 && ACPI) || COMPILE_TEST
	help
	  The Hydra Home Agent (HHA) is responsible for cache coherency
	  on the SoC. This drivers enables the cache maintenance functions of
	  the HHA.

	  This driver can be built as a module. If so, the module will be
	  called hisi_soc_hha.

endif

config AX45MP_L2_CACHE
	bool "Andes Technology AX45MP L2 Cache controller"
	depends on RISCV
	select RISCV_NONSTANDARD_CACHE_OPS
	help
	  Support for the L2 cache controller on Andes Technology AX45MP platforms.

config SIFIVE_CCACHE
	bool "Sifive Composable Cache controller"
	depends on ARCH_SIFIVE || ARCH_STARFIVE
	help
	  Support for the composable cache controller on SiFive platforms.

config STARFIVE_STARLINK_CACHE
	bool "StarFive StarLink Cache controller"
	depends on RISCV
	depends on ARCH_STARFIVE
	depends on 64BIT
	select RISCV_DMA_NONCOHERENT
	select RISCV_NONSTANDARD_CACHE_OPS
	help
	  Support for the StarLink cache controller IP from StarFive.

endmenu
```

## drivers/clk/cix/Kconfig
```kconfig
# SPDX-License-Identifier: GPL-2.0-only

config CLK_SKY1_ACPI
	tristate "CIX Sky1 ACPI clock lookup table support"
	depends on ACPI && COMMON_CLK_SCMI
	depends on ARM64
	default ARCH_CIX
	help
	  Parses CLKT tables in the CIX Sky1 DSDT to connect ACPI
	  consumer devices with SCMI-provided clocks. Required for
	  ACPI boot on Sky1 SoCs.

config CLK_SKY1_AUDSS
	bool "CIX Sky1 Audio Subsystem Clock Controller"
	depends on ARCH_CIX || COMPILE_TEST
	depends on MFD_SYSCON
	depends on COMMON_CLK
	default ARCH_CIX
	help
	  This enables the audio subsystem clock controller for CIX Sky1
	  SoCs. This is required for the audio subsystem including I2S
	  controllers and DSP.
```
