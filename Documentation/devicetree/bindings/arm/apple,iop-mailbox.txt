## Documentation/devicetree/bindings/arm/apple,iop-mailbox.txt
```
Apple IOP mailbox handler
--------------------------

Apple SoCs contain numerous IOPs (I/O Processors) that talk to the cores
running Linux (AP) over a common mailbox protocol. Each IOP has its own
instance of the mailbox interface, which typically carries multiple endpoints,
and many IOPs also follow a common initialization scheme to discover and start
available endpoints. It also provides standard memory grant features for
mandatory endpoints 1-4 (crash log, syslog, debug, stats report).

This driver provides a Linux mailbox for each endpoint.

Required properties:

- compatible : shall be "apple,iop-mailbox-m1" (for IOPs on M1 SoC)
- reg : MMIO area used by the IOP mailbox interface
- interrupts : two interrupt specifiers, a AP-to-IOP mailbox empty notifier,
	       and a IOP-to-AP message available notiifer
- #mbox-cells : should be <1> as the parameter cell specifies endpoint index
- endpoints : should contain a list of cells enumerating endpoints to be
	      exposed as mailboxes; if endpoint <0> is present, the common
	      initialization scheme is not used and mailbox client for this
	      endpoint can take over startup; if any of endpoints <1 2 3 4>
	      is present, built-in support for these mandatory endpoints is
	      not provided

Optional properties:

- wait-init : bool; if true, the common initialization scheme will start only
	      when the first message is sent to any endpoint; this allows
	      a client to initialize some non-mailbox hardware the mailbox
	      depends on before talking to the mailbox
- clocks : clocks to be brought up before the mailbox interface is used

Example:

        smc_mbox: smc_mbox@23e408800 {
            compatible = "apple,iop-mailbox-m1";
            reg = <0x2 0x3e400000 0x0 0x20000>;
            interrupts = <0 400 4   0 403 4>;

            #mbox-cells = <1>;
            endpoints = <32>;
        };
```

## Documentation/devicetree/bindings/arm/apple,pcie-m1.txt
```
PCIe on Apple ARM M1
---------------------

Apple M1 SoC includes three PCI Express root complexes. Two are used for
Thunderbolt and one for onboard devices such as WLAN, BT, USB or Ethernet.
This driver provides support for the complex used for onboard devices.

The driver exposes 3 PCIe root ports.

The driver requires the Apple DART driver as well as GPIO support, and needs
to be filled out with tunable values by bootloader based on information from
Apple firmware.

Required properties:

- compatible : shall be "apple,pcie-m1"
- device_type : "pci"
- reg : MMIO areas, in order:
	* configuration (ECAM) space
	* core and AXI bridge registers
	* port registers for each of 3 ports
- interrupts : interrupts used by driver, in order:
	* port interrupt for each of 3 ports
	* 32 MSI vectors
- clock-names : "core", "aux", "ref"
- clocks : three clocks to be brought up before the PCIe core, see above
- pinctrl-0 : reference to a pinctrl peripheral set corresponding to
	CLKREQ# pins (the driver will set them to peripheral mode)
- pinctrl-names : "default" (see above)
- perst-gpios : PERST# pin reference for each port
- clkreq-gpios : CLKREQ# pin reference for each port
- #address-cells : <3> (standard PCI bridge)
- #size-cells : <2>
- ranges : PCI to system range mapping used for BARs (standard PCI bridge)
- #interrupt-cells : <1> (MSI interrupts only)
- msi-controller : must be set
- msi-parent : must be set to self
- msi-doorbell : set to 64-bit address of MSI doorbell register, typically
	<0x0 0xfffff000>
- iommu-map : standard map of PCIe IOMMUs; refer to appropriate DARTs; since
	the Apple PCIe core actually maps DARTs by port number (not bus
	number as expected by iommu-map), this is somewhat fragile and relies
	on the mapping of ports to buses

Optional properties:

- devpwr-gpios : list of GPIOs used for powering on devices
- devpwr-on-%d : set of <gpio-index> <state> pairs executed before trying
	to talk to port %d; <gpio-index> refers to the devpwr-gpios table,
	and <state> is 0, 1, or 2 for "set to input"; if devpwr-on-%d is
	not present the port link is not initialized at all
- refclk-always-on-%d : forces PCIe REFCLK to be always provided for the
	specifed port %d (no clock gating)
- max-speed-%d : sets maximum speed allowed for port %d

Filled by bootloader:

- tunable-axi2af : settings applied to AXI bridge registers
- tunable-common : settings applied to root complex registers
- tunable-phy-ip-auspma : settings applied to PHY PMA registers
- tunable-phy-ip-pll : settings applied to PHY PLL registers
- tunable-phy : settings applied to PHY core registers
- tunable-fuse : settings applied to PHY registers based on on-chip fuses
- tunable-port%d-config : settings applied to port registers for port %d
- tunable-port%d : PCIe Gen1/2 settings applied to port config space
- tunable-port%d-gen3-shadow : PCIe Gen3 settings applied to port config space
- tunable-port%d-gen4-shadow : PCIe Gen4 settings applied to port config space

Example:

        pcie: pcie@690000000 {
            compatible = "apple,pcie-m1";
            reg = <0x6 0x90000000 0x0 0x1000000                                                                 /* config */
                   0x6 0x80000000 0x0 0x100000  0x6 0x8c000000 0x0 0x100000                                     /* core and AXI bridge */
                   0x6 0x81000000 0x0 0x20000   0x6 0x82000000 0x0 0x20000   0x6 0x83000000 0x0 0x20000>;       /* ports */
            interrupt-parent = <&aic>;
            interrupts = <0 695 4   0 698 4   0 701 4                                                           /* state */
                          0 704 1   0 705 1   0 706 1   0 707 1   0 708 1   0 709 1   0 710 1   0 711 1         /* MSI */
                          0 712 1   0 713 1   0 714 1   0 715 1   0 716 1   0 717 1   0 718 1   0 719 1
                          0 720 1   0 721 1   0 722 1   0 723 1   0 724 1   0 725 1   0 726 1   0 727 1
                          0 728 1   0 729 1   0 730 1   0 731 1   0 732 1   0 733 1   0 734 1   0 735 1>;
            clocks = <&pcie_gp_clk &pcie_clk &pcie_refclk>;
            clock-names = "core", "aux", "ref";
            pinctrl-0 = <&pcie_clkreq_pins>;
            pinctrl-names = "default";
            perst-gpios = <&gpio 152 0   &gpio 153 0   &gpio 33 0>;
            clkreq-gpios = <&gpio 150 0   &gpio 151 0   &gpio 32 0>;
            devpwr-gpios = <&smc 13 0>;
            devpwr-on-0 = <0 1>;
            devpwr-on-1 = <>;
            devpwr-on-2 = <>;
            #address-cells = <3>;
            #size-cells = <2>;
            #interrupt-cells = <1>;
            device_type = "pci";
            msi-controller;
            msi-parent = <&pcie>;
            msi-doorbell = <0x0 0xfffff000>;
            ranges = <0x43000000   0x6 0xa0000000   0x6 0xa0000000 0x0 0x20000000
                      0x02000000   0x0 0xc0000000   0x6 0xc0000000 0x0 0x40000000>;
            bus-range = <0x00 0x0f>;
            iommu-map = <0x0000 &pcie_dart0 0x8000 0x0100>, /* fake, and should never be used as RC bridges don't DMA */
                        <0x0100 &pcie_dart0 0x0000 0x0100>,
                        <0x0200 &pcie_dart1 0x0000 0x0100>,
                        <0x0300 &pcie_dart2 0x0000 0x0100>;
            refclk-always-on-2;
            max-speed-2 = <1>; /* 2.5 GT/s */
        };
```

## Documentation/devicetree/bindings/arm/apple,smc-m1.txt
```
Apple SMC on ARM SoCs
----------------------

All Apple ARM SoCs since A11 (including the M1) contain a coprocessor called
SMC. It has similar functionality but a different interface than the SMC on
Apple x86 systems.

The SMC provides hardware monitoring (temperature, voltage, battery) and some
control functions exposed as GPIOs (they are likely physically GPIOs on the
system PMIC, managed through SMC).

The driver requires the Apple IOP mailbox driver to function.

Required properties:

- compatible : shall be "apple,smc-m1" (for SMC on M1 SoC)
- reg : MMIO area used by the non-mailbox interface (ARM core control MMIO)
- mboxes : should be a reference to one mailbox, typically <32>, on an IOP
	   mailbox instance
- gpio-controller : should be present as the SMC provides up to 32 GPIOs
- #gpio-cells : should be <2>

Optional properties:

- gpio-%d : where %d is index of the GPIO, and the contents of the property
	    is a bit pattern applied when setting the GPIO; this marks the
	    GPIO as available to clients and allows it to be set

Example:

        smc: smc@23e050000 {
            compatible = "apple,smc-m1";
            reg = <0x2 0x3e050000 0x0 0x4000>;
            mboxes = <&smc_mbox 32>;

            gpio-controller;
            #gpio-cells = <2>;
            gpio-9 = <0x10000>;
            gpio-13 = <0x800000>;
            gpio-15 = <0>;
            gpio-20 = <0>;
        };
```

## Documentation/devicetree/bindings/arm/io-ranges.txt
```
* MMIO type ranges in device tree

Some platforms require specific device access type for specific SoC buses.
For instance,  Apple ARM hardware requires different MMIO accesses in PCIe
and on-chip MMIO areas.  This device-tree binding allows specifying the
access type on a per-range basis.

The io-ranges node at / of device tree does not represent a real device,
but contains a list of MMIO address ranges, similar to reserved-memory.

Required properties:

- reg: the MMIO region of the range
- type: type of access used for that region:
    0 - nGnRE
    1 - nGnRnE

Example:

/ {
	io-ranges {
		#address-cells = <0x2>;
		#size-cells = <0x2>;
		ranges;

		on_chip_io@200000000 {
			reg = <0x2 0x00000000 0x2 0x00000000>;
			type = <1>;
		};

		/* ... */
	};
};
```

## Documentation/devicetree/bindings/ata/allwinner,sun4i-a10-ahci.txt
```
Allwinner A10/A20/R40 SoC SATA AHCI Controller

Required properties:
- compatible        : compatible string, one of:
  - "allwinner,sun4i-a10-ahci"
  - "allwinner,sun8i-r40-ahci"
- interrupts        : the SATA IRQ
- reg               : the register mapping
- clocks            : the clocks needed by SATA controller, usually contains
		      an AHB clock and a mod clock

Optional properties:
- target-supply     : regulator for SATA target power

Required properties for the following compatibles:
  - "allwinner,sun8i-r40-ahci"
- resets            : the reset control needed by SATA controller
- vdd1v2-supply     : regulator for SATA controller's 1.2V VDD
- vdd2v5-supply     : regulator for SATA controller's 2.5V VDD


Examples for A10:
	ahci: sata@1c18000 {
		compatible = "allwinner,sun4i-a10-ahci";
		reg = <0x01c18000 0x1000>;
		interrupts = <56>;
		clocks = <&pll6 0>, <&ahb_gates 25>;
		target-supply = <&reg_ahci_5v>;
	};

Examples for R40:
	ahci: sata@1c18000 {
		compatible = "allwinner,sun8i-r40-ahci";
		reg = <0x01c18000 0x1000>;
		interrupts = <GIC_SPI 56 IRQ_TYPE_LEVEL_HIGH>;
		clocks = <&ccu CLK_SATA>, <&ccu CLK_BUS_SATA>;
		resets = <&ccu RST_BUS_SATA>;
		vdd1v2-supply = <&reg_eldo3>;
		vdd2v5-supply = <&reg_dldo4>;
	};
```

## Documentation/devicetree/bindings/cpufreq/apple,soc-cpufreq.yaml
```yaml
# SPDX-License-Identifier: GPL-2.0-only OR BSD-2-Clause
%YAML 1.2
---
$id: http://devicetree.org/schemas/cpufreq/apple,soc-cpufreq.yaml#
$schema: http://devicetree.org/meta-schemas/core.yaml#

title: Apple SoC cpufreq device

maintainers:
  - Hector Martin <marcan@marcan.st>

description: |
  Apple SoCs (e.g. M1) have a per-cpu-cluster DVFS controller that is part of
  the cluster management register block. This binding uses the standard
  operating-points-v2 table to define the CPU performance states, with the
  opp-level property specifying the hardware p-state index for that level.

properties:
  compatible:
    items:
      - enum:
          - apple,t8103-soc-cpufreq
          - apple,t6000-soc-cpufreq
      - const: apple,soc-cpufreq

  reg:
    minItems: 1
    maxItems: 6
    description: One register region per CPU cluster DVFS controller

  reg-names:
    minItems: 1
    items:
      - const: cluster0
      - const: cluster1
      - const: cluster2
      - const: cluster3
      - const: cluster4
      - const: cluster5

  '#freq-domain-cells':
    const: 1

required:
  - compatible
  - reg
  - reg-names
  - '#freq-domain-cells'

additionalProperties: false

examples:
  - |
    // This example shows a single CPU per domain and 2 domains,
    // with two p-states per domain.
    // Shipping hardware has 2-4 CPUs per domain and 2-6 domains.
    cpus {
      #address-cells = <2>;
      #size-cells = <0>;

      cpu@0 {
        compatible = "apple,icestorm";
        device_type = "cpu";
        reg = <0x0 0x0>;
        operating-points-v2 = <&ecluster_opp>;
        apple,freq-domain = <&cpufreq_hw 0>;
      };

      cpu@10100 {
        compatible = "apple,firestorm";
        device_type = "cpu";
        reg = <0x0 0x10100>;
        operating-points-v2 = <&pcluster_opp>;
        apple,freq-domain = <&cpufreq_hw 1>;
      };
    };

    ecluster_opp: opp-table-0 {
      compatible = "operating-points-v2";
      opp-shared;

      opp01 {
        opp-hz = /bits/ 64 <600000000>;
        opp-level = <1>;
        clock-latency-ns = <7500>;
      };
      opp02 {
        opp-hz = /bits/ 64 <972000000>;
        opp-level = <2>;
        clock-latency-ns = <22000>;
      };
    };

    pcluster_opp: opp-table-1 {
      compatible = "operating-points-v2";
      opp-shared;

      opp01 {
        opp-hz = /bits/ 64 <600000000>;
        opp-level = <1>;
        clock-latency-ns = <8000>;
      };
      opp02 {
        opp-hz = /bits/ 64 <828000000>;
        opp-level = <2>;
        clock-latency-ns = <19000>;
      };
    };

    soc {
      #address-cells = <2>;
      #size-cells = <2>;

      cpufreq_hw: cpufreq@210e20000 {
        compatible = "apple,t8103-soc-cpufreq", "apple,soc-cpufreq";
        reg = <0x2 0x10e20000 0 0x1000>,
              <0x2 0x11e20000 0 0x1000>;
        reg-names = "cluster0", "cluster1";
        #freq-domain-cells = <1>;
      };
    };
```

## Documentation/devicetree/bindings/display/simple-framebuffer-sunxi.txt
```
Sunxi specific Simple Framebuffer bindings

This binding documents sunxi specific extensions to the simple-framebuffer
bindings. The sunxi simplefb u-boot code relies on the devicetree containing
pre-populated simplefb nodes.

These extensions are intended so that u-boot can select the right node based
on which pipeline is being used. As such they are solely intended for
firmware / bootloader use, and the OS should ignore them.

Required properties:
- compatible: "allwinner,simple-framebuffer"
- allwinner,pipeline, For the first generation DE, one of:
  "de_be0-lcd0"
  "de_be1-lcd1"
  "de_be0-lcd0-hdmi"
  "de_be1-lcd1-hdmi"
  For DE2 without TCON_TOP, one of:
  "mixer0-lcd0"
  "mixer0-lcd0-hdmi"
  "mixer1-lcd1-hdmi"
  "mixer1-lcd1-tve"
  For DE2/3 with TCON_TOP, one of:
  "mixer0-tcon_tv0-hdmi"
  "mixer0-tcon_lcd0"

Example:

chosen {
	#address-cells = <1>;
	#size-cells = <1>;
	ranges;

	framebuffer@0 {
		compatible = "allwinner,simple-framebuffer", "simple-framebuffer";
		allwinner,pipeline = "de_be0-lcd0-hdmi";
		clocks = <&pll5 1>, <&ahb_gates 36>, <&ahb_gates 43>,
			 <&ahb_gates 44>;
	};
};
```
