// SPDX-License-Identifier: GPL-2.0
/*
 * Copyright (C) 2025 Loongson Technology Corporation Limited
 */

/dts-v1/;

#include "loongson-2k0300.dtsi"
#include "loongson_panel_param.dtsi"
#include "ls2k300_99pi.dtsi"

/ {
	product = "LS2K300-99PI-WIFI";

	sdio_pwrseq: sdio-pwrseq {
		compatible = "mmc-pwrseq-simple";
		pinctrl-names = "default";
		pinctrl-0 = <&sdio0en>;
		reset-gpios = <&gpio 81 GPIO_ACTIVE_HIGH>;
	};

};

&pinmux {
	sdio0en: pinmux_G81_as_sdio0en {
		pinctrl-single,bits = <0x14 0x00000000 0x0000000c>;
	};
};
