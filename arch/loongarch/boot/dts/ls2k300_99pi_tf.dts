// SPDX-License-Identifier: GPL-2.0
/*
 * Copyright (C) 2025 Loongson Technology Corporation Limited
 */

/dts-v1/;

#include "loongson-2k0300.dtsi"
#include "loongson_panel_param.dtsi"
#include "ls2k300_99pi.dtsi"

/ {
	model = "LS2K300-99PI-TF";
};

&emmc {
	status = "disabled";
};
